## conf/distro/include/default-providers.inc
```bitbake
PREFERRED_PROVIDER_udev = "${@base_contains('DISTRO_FEATURES','systemd','systemd','udev',d)}"
```

## conf/layer.conf
```bitbake
# We have a conf and classes directory, append to BBPATH
BBPATH .= ":${LAYERDIR}"

# We have a recipes directory, add to BBFILES
BBFILES += "${LAYERDIR}/recipes*/*/*.bb ${LAYERDIR}/recipes*/*/*.bbappend ${LAYERDIR}/images/*.bb"

BBFILE_COLLECTIONS += "blanket-layer"
BBFILE_PATTERN_blanket-layer := "^${LAYERDIR}/"
BBFILE_PRIORITY_blanket-layer = "7"
```
